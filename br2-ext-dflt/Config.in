## br2-ext-dflt/Config.in
```kconfig
source "$BR2_EXTERNAL_DFLT_PATH/package/adsbhub/Config.in"
source "$BR2_EXTERNAL_DFLT_PATH/package/dump1090-service/Config.in"
source "$BR2_EXTERNAL_DFLT_PATH/package/fr24feed/Config.in"
source "$BR2_EXTERNAL_DFLT_PATH/package/restart/Config.in"
```

## br2-ext-dflt/package/dump1090-service/Config.in
```kconfig
config BR2_PACKAGE_DUMP1090_SERVICE
	bool "dump1090-service"
	depends on BR2_PACKAGE_DUMP1090
	select BR2_PACKAGE_RESTART
	help
	  Enable dump1090 to start at boot
```

## br2-ext-dflt/package/restart/Config.in
```kconfig
config BR2_PACKAGE_RESTART
	bool "restart"
	help
	  Restart infinitely a binary if it exits
```
